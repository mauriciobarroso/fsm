## Kconfig
```kconfig
menu "FSM Configuration"

    config FSM_TRANS_NUM_MAX
        int "Maximum number of FSM transitions"
        default 20
        help
        	Set the maximum number of FSM states transitions.
        	
    config FSM_STATES_NUM_MAX
        int "Maximum number o FSM states"
        default 10
        help
        	Set the maximum number of FSM states.

endmenu
```
